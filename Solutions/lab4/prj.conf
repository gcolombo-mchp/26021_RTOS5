## CMakeLists.txt
```
# SPDX-License-Identifier: Apache-2.0

cmake_minimum_required(VERSION 3.20.0)
list(APPEND BOARD_ROOT ${CMAKE_CURRENT_SOURCE_DIR}/..)
find_package(Zephyr REQUIRED HINTS $ENV{ZEPHYR_BASE})
project(lab4)

target_sources(app PRIVATE src/main.c src/usb.c)
```

## prj.conf
```kconfig
CONFIG_GPIO=y

CONFIG_INPUT=y
CONFIG_USB_DEVICE_STACK_NEXT=y
# CONFIG_USBD_CDC_ACM_CLASS=y
# CONFIG_CDC_ACM_SERIAL_VID=0x04D8
# CONFIG_CDC_ACM_SERIAL_PID=0x000A
# CONFIG_CDC_ACM_SERIAL_MAX_POWER=250
# CONFIG_CDC_ACM_SERIAL_MANUFACTURER_STRING="Microchip Technology Inc."
# CONFIG_CDC_ACM_SERIAL_PRODUCT_STRING="Zephyr CDC-ACM Console"
# CONFIG_CDC_ACM_SERIAL_INITIALIZE_AT_BOOT=y
# CONFIG_CDC_ACM_SERIAL_ENABLE_AT_BOOT=y
# CONFIG_CONSOLE_SUBSYS=y
# CONFIG_CONSOLE_GETCHAR=y

# CONFIG_SERIAL=y
# CONFIG_UART_INTERRUPT_DRIVEN=y
# CONFIG_UART_LINE_CTRL=y
CONFIG_HWINFO=y

CONFIG_USBD_HID_SUPPORT=y
```

## app.overlay
```dts
// / {
// 	chosen {
// 		zephyr,console = &cdc_acm_uart;
// 	};
// };

&zephyr_udc0 {
	// cdc_acm_uart: cdc_acm_uart {
	// 	compatible = "zephyr,cdc-acm-uart";
	// 	label = "Zephyr USB CDC-ACM";
	// };

	hid0: hid0 {
		compatible = "zephyr,hid-device";
		protocol-code = "none";
		in-report-size = <64>;
		out-report-size = <64>;
		in-polling-period-us = <1000>;
		out-polling-period-us = <1000>;
	};
};
```

## src/main.c
```c
/*
 * Copyright (c) 2016 Intel Corporation
 *
 * SPDX-License-Identifier: Apache-2.0
 */

//#include <stdio.h>
#include <zephyr/kernel.h>
#include <zephyr/drivers/gpio.h>

// #include <zephyr/console/console.h>
#include <zephyr/input/input.h>

#include "usb.h"

// #define SW0_CODE DT_PROP(DT_NODELABEL(button0), zephyr_code)

/* 1000 msec = 1 sec */
#define SLEEP_TIME_MS   1000

/* The devicetree node identifier for the "led0" alias. */
#define LED0_NODE DT_ALIAS(led0)

/*
 * A build error on this line means your board is unsupported.
 * See the sample documentation for information on how to fix this.
 */
static const struct gpio_dt_spec led = GPIO_DT_SPEC_GET(LED0_NODE, gpios);

// vcp_buffer data_to_send;
// vcp_buffer received_data;

#define VBUS_CODE DT_PROP(DT_NODELABEL(vbus0), zephyr_code)

static void input_cb(struct input_event *event, void *user_data)
{

    if (!managed_vbus) {
        if (event->code == VBUS_CODE) {
            if (event->value) {
                manage_usb_device(true);
            }
            else {
                manage_usb_device(false);
            }
        }
    }

    // if (event->code == SW0_CODE) {
    //     if (event->value) {
    //         // printk("Button pressed!\n");

    //         data_to_send.length = sprintf(data_to_send.buf, "Button pressed!\n\r");
    //         uart_irq_tx_enable(cdc_dev);
        
    //     }
    // }
    return;
}
INPUT_CALLBACK_DEFINE(NULL, input_cb, NULL);

// void uart_irq_cb(const struct device *dev, void *user_data) 
// {
//     static bool led_state = true;
//     while (uart_irq_update(dev) && uart_irq_is_pending(dev)) {
     
//         if (uart_irq_rx_ready(dev)) {
//             received_data.length = uart_fifo_read(dev, received_data.buf, sizeof(received_data.buf));
//             if (received_data.length > 0) {
//                 if (received_data.buf[0] == 'T') {
//                     gpio_pin_toggle_dt(&led);
//                     led_state = !led_state;
//                     data_to_send.length = sprintf(data_to_send.buf, "LED state: %s\n\r", led_state ? "ON" : "OFF");
//                 } 
//                 else {
//                     data_to_send.length = sprintf(data_to_send.buf, "Received character: %c\n\r", received_data.buf[0]);
//                 }
//                 uart_irq_tx_enable(dev);
//             }
//         }

//         if (uart_irq_tx_ready(dev)) {
//             uart_fifo_fill(dev, data_to_send.buf, data_to_send.length);
//             uart_irq_tx_disable(dev);
//         }
        
//     }
// }

static const struct gpio_dt_spec vbus_gpio = GPIO_DT_SPEC_GET(DT_NODELABEL(vbus0), gpios);

static const struct gpio_dt_spec button = GPIO_DT_SPEC_GET(DT_NODELABEL(button0), gpios);

int hid_get_report_cb(const struct device *dev, const uint8_t type, const uint8_t id, const uint16_t len, uint8_t *const buf)
{
 return -ENOTSUP;
}
int hid_set_report_cb(const struct device *dev, const uint8_t type, const uint8_t id, const uint16_t len, const uint8_t *const buf)
{
 return -ENOTSUP;
}

bool led_state = true;
void hid_output_report_cb(const struct device *dev, const uint16_t len, const uint8_t *const buf)
{
    static uint8_t input_report[64];
    
    if (len > 0 && buf != NULL) {
        switch (buf[0]) {
            case 0x80: {

                if(gpio_pin_toggle_dt(&led) != 0) {
                    return;
                }
                led_state = !led_state;

                break;
            }
            case 0x81: {

                input_report[0] = buf[0];
                if (gpio_pin_get_dt(&button)) {
                    input_report[1] = 0;
                }
                else {
                    input_report[1] = 1;
                }
                hid_device_submit_report(dev, 64, input_report);

                break;
            }
        }
    }
}

void hid_input_report_done_cb(const struct device *dev, const uint8_t *const report)
{
    printk("LED state: %s\n", led_state ? "ON " : "OFF");
    printk("Button is %s\n\e[F\e[F", report[1] ? "not pressed" : "pressed    ");
}

int main(void)
{
	int ret;
	// bool led_state = true;

	if (!gpio_is_ready_dt(&led)) {
		return 0;
	}

	ret = gpio_pin_configure_dt(&led, GPIO_OUTPUT_ACTIVE);
	if (ret < 0) {
		return 0;
	}

    if (!gpio_is_ready_dt(&button)) {
        return 0;
    }
    ret = gpio_pin_configure_dt(&button, GPIO_INPUT);
    if (ret < 0) {
        return 0;
    }

    // ret = console_init();
	// if (ret<0)
	// {
	// 	return 0;
	// }
	// printk("\nPress T on the keyboard to toggle the LED 0\n - or -\nPress SW0 on the board to receive a message\n\n");
	
    if (!device_is_ready(hid_dev)) {
        return 0;
    }

    ret = init_usb_device();
    if (ret <0) {
        return 0;
    }

    // uart_irq_callback_set(cdc_dev, uart_irq_cb);
    // uart_irq_rx_enable(cdc_dev);

    if (!managed_vbus) {
        if (gpio_pin_get_dt(&vbus_gpio)) {
            manage_usb_device(true);
        }
    }
    
    while (1) {
        // unsigned char chr = console_getchar();
        // if (chr == 'T' ) {
        //     ret = gpio_pin_toggle_dt(&led);
        //     if (ret < 0) {
        //        return 0;
        //     }
    
        //     led_state = !led_state;
        //     printf("LED state: %s\n", led_state ? "ON" : "OFF");
        k_msleep(SLEEP_TIME_MS);
        // }
        // else {
        //     printk("Received character: %c\n", chr);
        // }
    }
	
	return 0;
}
```

## src/usb.c
```c
#include "usb.h"
//const struct device *cdc_dev = DEVICE_DT_GET(DT_NODELABEL(cdc_acm_uart));

const struct device *hid_dev = DEVICE_DT_GET(DT_NODELABEL(hid0));

USBD_DEVICE_DEFINE(usbd_ctx, DEVICE_DT_GET(DT_NODELABEL(zephyr_udc0)), 0x04D8, 0x003F);

USBD_DESC_LANG_DEFINE(lang_desc);
USBD_DESC_MANUFACTURER_DEFINE(mfr_desc, "Microchip Technology Inc.");
USBD_DESC_PRODUCT_DEFINE(prod_desc, "Zephyr vendor HID");
USBD_DESC_SERIAL_NUMBER_DEFINE(sn_desc);

USBD_DESC_CONFIG_DEFINE(fs_cfg_desc, "FS Configuration");
USBD_CONFIGURATION_DEFINE(fs_config, USB_SCD_SELF_POWERED, 50, &fs_cfg_desc);

void usb_msg_callback(struct usbd_context *const ctx, const struct usbd_msg *const msg)
{
    if (usbd_can_detect_vbus(ctx)) {
        switch (msg->type)
        {
        case USBD_MSG_VBUS_READY:
            manage_usb_device(true);
            break;
        case USBD_MSG_VBUS_REMOVED:
            manage_usb_device(false);
            break;
        default:
            break;
        }
    }
}

bool managed_vbus;

const uint8_t hid_report_descriptor[] = {
    0x06, 0x00, 0xFF,      // Usage Page (Vendor Defined 0xFF00)
    0x09, 0x01,            // Usage (Vendor Usage 1)
    0xA1, 0x01,            // Collection (Application)

    // Input Report: 64 bytes (to host)
    0x15, 0x00,            //   Logical Minimum (0)
    0x25, 0xFF,            //   Logical Maximum (255)
    0x75, 0x08,            //   Report Size (8 bits/element)
    0x95, 0x40,            //   Report Count (64 elements)
    0x09, 0x01,            //   Usage (Vendor Usage 1)
    0x81, 0x02,            //   Input (Data, Variable, Absolute)

    // Output Report: 64 bytes (to device)
    0x15, 0x00,            //   Logical Minimum (0)
    0x25, 0xFF,            //   Logical Maximum (255)
    0x75, 0x08,            //   Report Size (8 bits/element)
    0x95, 0x40,            //   Report Count (64 elements)
    0x09, 0x01,            //   Usage (Vendor Usage 1)
    0x91, 0x02,            //   Output (Data, Variable, Absolute)

    0xC0                   // End Collection
};

struct hid_device_ops hid_ops = {
    .get_report = hid_get_report_cb,
    .set_report = hid_set_report_cb,
    .input_report_done = hid_input_report_done_cb,
    .output_report = hid_output_report_cb,
};

int init_usb_device(void)
{

    int err = 0;
    err = usbd_add_descriptor(&usbd_ctx, &lang_desc);
    if (err) {
        return err;
    }
    err = usbd_add_descriptor(&usbd_ctx, &mfr_desc);
    if (err) {
        return err;
    }
    err = usbd_add_descriptor(&usbd_ctx, &prod_desc);
    if (err) {
        return err;
    }
    err = usbd_add_descriptor(&usbd_ctx, &sn_desc);
    if (err) {
        return err;
    }

    err = usbd_add_configuration(&usbd_ctx, USBD_SPEED_FS, &fs_config);
    if (err) {
        return err;
    }

    // err = usbd_register_class(&usbd_ctx, "cdc_acm_0", USBD_SPEED_FS, 1);
    // if (err) {
    //     return err;
    // }

    err = usbd_register_class(&usbd_ctx, "hid_0", USBD_SPEED_FS, 1);
    if (err) {
        return err;
    }
    err = hid_device_register(hid_dev, hid_report_descriptor, sizeof(hid_report_descriptor), &hid_ops);
    if (err) {
        return err;
    }
    err = usbd_device_set_code_triple(&usbd_ctx, USBD_SPEED_FS, 0, 0, 0);
    if (err) {
        return err;
    }

    err = usbd_msg_register_cb(&usbd_ctx, usb_msg_callback);
    if (err) {
        return err;
    }

    err = usbd_init(&usbd_ctx);
    if (err) {
        return err;
    }

    managed_vbus = usbd_can_detect_vbus(&usbd_ctx);
    return err;

}

void manage_usb_device(bool connected)
{

    if (connected) {
        usbd_enable(&usbd_ctx);
        // uint32_t dtr = 0;
        // while (!dtr) {
        //     uart_line_ctrl_get(cdc_dev, UART_LINE_CTRL_DTR, &dtr);
        //     k_sleep(K_MSEC(100));
        // }
        // data_to_send.length = sprintf(data_to_send.buf, "\nPress T on the keyboard to toggle the LED 0\n - or -\nPress SW0 on the board to receive a message\n\n");
        // uart_irq_tx_enable(cdc_dev);
    }
    else {
        usbd_disable(&usbd_ctx);
    }

}
```

## src/usb.h
```c
#include <zephyr/usb/usbd.h>
// #include <zephyr/drivers/uart.h>

#include <zephyr/usb/class/usbd_hid.h>
extern const struct device *hid_dev;

//extern const struct device *cdc_dev;

extern bool managed_vbus;
int init_usb_device(void);

void manage_usb_device(bool connected);

typedef struct {
    uint8_t buf[128];
    uint16_t length; 
} vcp_buffer;
extern vcp_buffer data_to_send;

int hid_get_report_cb(const struct device *dev, const uint8_t type, const uint8_t id, const uint16_t len, uint8_t *const buf);
int hid_set_report_cb(const struct device *dev, const uint8_t type, const uint8_t id, const uint16_t len, const uint8_t *const buf);
void hid_output_report_cb(const struct device *dev, const uint16_t len, const uint8_t *const buf);
void hid_input_report_done_cb(const struct device *dev, const uint8_t *const report);
```
